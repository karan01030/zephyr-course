## app/boards/my_board/board.yml
```yaml
board:
  name: my_board
  full_name: My Board from stratch
  vendor: keval
  socs:
    - name: stm32f407xx
```

## app/boards/our_board/board.yml
```yaml
board:
  name: our_board
  full_name: Our Board
  vendor: keval
  socs:
    - name: stm32f407xx
```
